## config/boards/shields/nice_view_gem/nice_view_gem/Kconfig.defconfig
```kconfig
if SHIELD_NICE_VIEW_GEM
    config ZMK_DISPLAY
        default y

    # Erzwinge die Treiber-Werte
    config LS0XX_DRV_WIDTH
        default 160

    config LS0XX_DRV_HEIGHT
        default 160

    config LV_Z_VDB_CUSTOM
        default y
    
    config LV_VDB_SIZE
        default 64

    # Rotation für die vertikale Ansicht
    config LV_Z_ROTATE_90
        default y
endif
```

## config/west.yml
```yaml
manifest:
  remotes:
    - name: zmkfirmware
      url-base: https://github.com/zmkfirmware
  projects:
    - name: zmk
      remote: zmkfirmware
      revision: v0.3-branch
      import: app/west.yml
    - name: zmk-view
      remote: zmkfirmware
      repo-path: ../NickConroy/zmk-view
      revision: main
  self:
    path: config
```
