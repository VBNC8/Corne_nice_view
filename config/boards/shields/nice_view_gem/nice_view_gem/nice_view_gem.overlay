&nice_view_spi {
    nice_view: ls0xx@0 {
        compatible = "sharp,ls0xx";
        reg = <0>;
        spi-max-frequency = <1000000>;
        width = <160>;
        height = <160>; /* Wir lügen den Treiber an, damit die Mathematik stimmt */
    };
};

/ {
    chosen {
        zmk,display = &nice_view;
    };
};
